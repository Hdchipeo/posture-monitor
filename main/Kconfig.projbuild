## main/Kconfig.projbuild
```kconfig
menu "Posture Monitor Configuration"

    menu "Hardware Pin Assignment"
        config POSTURE_I2C_SDA_GPIO
            int "MPU6050 I2C SDA GPIO"
            default 21 if IDF_TARGET_ESP32
            default 8 if IDF_TARGET_ESP32C3
            default 21
            range 0 39
            help
                GPIO number assigned to the I2C Data Line (SDA).
                NOTE for ESP32 Classic: Avoid GPIO 6-11 (connected to internal SPI flash).
                Recommended for ESP32: GPIO 21. For ESP32-C3: GPIO 4 or GPIO 8.

        config POSTURE_I2C_SCL_GPIO
            int "MPU6050 I2C SCL GPIO"
            default 22 if IDF_TARGET_ESP32
            default 9 if IDF_TARGET_ESP32C3
            default 22
            range 0 39
            help
                GPIO number assigned to the I2C Clock Line (SCL).
                NOTE for ESP32 Classic: Avoid GPIO 6-11 (connected to internal SPI flash).
                Recommended for ESP32: GPIO 22. For ESP32-C3: GPIO 5 or GPIO 9.

        config POSTURE_I2C_PORT_NUM
            int "I2C Port Number"
            default 0
            range 0 1
            help
                I2C Port Controller (0 or 1 on ESP32, 0 on ESP32-C3).

        config POSTURE_I2C_FREQ_HZ
            int "I2C Clock Speed (Hz)"
            default 400000
            help
                Bus clock speed in Hz (100000 for Standard Mode, 400000 for Fast Mode).

        config POSTURE_VIBRATION_GPIO
            int "Vibration Motor Drive GPIO"
            default 18 if IDF_TARGET_ESP32
            default 6 if IDF_TARGET_ESP32C3
            default 18
            range 0 39
            help
                GPIO output connected to the N-channel MOSFET gate controlling the vibration motor.
                WARNING: Do NOT use GPIO 6-11 on ESP32 (SPI Flash)! Safe options: GPIO 18, 4, 16, 23.

        config POSTURE_BUZZER_GPIO
            int "Buzzer Drive GPIO"
            default 19 if IDF_TARGET_ESP32
            default 7 if IDF_TARGET_ESP32C3
            default 19
            range 0 39
            help
                GPIO output connected to the buzzer switching circuit.
                WARNING: Do NOT use GPIO 6-11 on ESP32 (SPI Flash)! Safe options: GPIO 19, 5, 17, 25.

        config POSTURE_BUTTON_GPIO
            int "Calibration / Tare Button GPIO"
            default 0 if IDF_TARGET_ESP32
            default 0 if IDF_TARGET_ESP32C3
            default 0
            range 0 39
            help
                GPIO connected to the calibration pushbutton (active LOW with pull-up).
                On most ESP32 devkits, GPIO 0 is the onboard 'BOOT' button.
    endmenu

    menu "Algorithm & Signal Processing"
        config POSTURE_SAMPLING_RATE_HZ
            int "IMU Sampling Frequency (Hz)"
            default 50
            range 10 200
            help
                Rate at which the MPU6050 is polled and the complementary filter is updated.

        config POSTURE_FILTER_ALPHA_X100
            int "Complementary Filter Alpha (x100)"
            default 96
            range 50 99
            help
                Weight allocated to the gyroscope high-pass integration (e.g. 96 represents 0.96).
                Accelerometer weight will be (100 - Alpha) / 100.

        config POSTURE_ANGLE_THRESHOLD_DEG
            int "Slouch Angle Threshold (Degrees)"
            default 15
            range 5 45
            help
                Angular deviation limit in degrees from calibrated baseline before triggering slouch detection.
    endmenu

    menu "Alert & Escalation Timers"
        config POSTURE_SLOUCH_TOLERANCE_TIME_S
            int "Slouch Grace Time before Level 1 Haptic Alert (Seconds)"
            default 5
            range 1 60
            help
                Duration in seconds that slouching must persist before triggering mild haptic pulses.

        config POSTURE_ESCALATION_TIME_S
            int "Escalation Delay before Level 2 Buzzer Alarm (Seconds)"
            default 15
            range 5 120
            help
                Time in seconds from initial Level 1 warning before escalating to combined vibration and audio alarm.

        config POSTURE_ENABLE_BUZZER
            bool "Enable Audible Buzzer Alerts"
            default y
            help
                If disabled, the device will operate in silent haptic-only mode.
    endmenu

    menu "Storage & Calibration"
        config POSTURE_NVS_NAMESPACE
            string "NVS Namespace for Calibration Storage"
            default "posture_cfg"
            help
                Namespace string used in Non-Volatile Storage (NVS).

        config POSTURE_CALIBRATION_SAMPLES
            int "Number of Samples for Zero-Reference Calibration"
            default 100
            range 20 500
            help
                Number of IMU readings averaged when computing the neutral posture baseline.
    endmenu

endmenu
```

## sdkconfig.defaults
```kconfig
CONFIG_IDF_TARGET="esp32c3"

# Compiler Options
CONFIG_COMPILER_OPTIMIZATION_PERF=y

# FreeRTOS
CONFIG_FREERTOS_HZ=1000

# Log output
CONFIG_LOG_DEFAULT_LEVEL_INFO=y

# Power Management
# Disable tickless idle and sleep GPIO isolation in active wearable
CONFIG_PM_ENABLE=n
CONFIG_FREERTOS_USE_TICKLESS_IDLE=n

# HTTP Server & WebSocket Configuration
CONFIG_HTTPD_WS_SUPPORT=y
CONFIG_HTTPD_MAX_REQ_HDR_LEN=2048
CONFIG_HTTPD_MAX_URI_LEN=1024
CONFIG_HTTPD_MAX_OPEN_SOCKETS=7
# Status LED Configuration
CONFIG_POSTURE_STATUS_LED_GPIO=5
CONFIG_POSTURE_STATUS_LED_ACTIVE_LEVEL=1

# Flash Size & OTA Partition Table
CONFIG_ESPTOOLPY_FLASHSIZE_4MB=y
CONFIG_ESPTOOLPY_FLASHSIZE="4MB"
CONFIG_PARTITION_TABLE_CUSTOM=y
CONFIG_PARTITION_TABLE_CUSTOM_FILENAME="partitions.csv"
CONFIG_PARTITION_TABLE_FILENAME="partitions.csv"
CONFIG_BOOTLOADER_APP_ROLLBACK_ENABLE=y
```
